#include "FileManager.h"

// Global variables
String currentLogFile = "";
bool isLogging = false;
unsigned long lastLogTime = 0;
int testCounter = 0;
bool testMode = false;

// Variables that main.cpp needs access to
bool autoIsOn = false;
unsigned long lastAutoCheckTime = 0;

bool setupSPIFFS() {
  if (!SPIFFS.begin(true)) {
    Serial.println("SPIFFS Mount Failed, formatting...");
    SPIFFS.format();
    if (!SPIFFS.begin()) {
      Serial.println("SPIFFS Mount Failed after formatting!");
      return false;
    }
  }

  Serial.println("SPIFFS geïnitialiseerd");
  return true;
}

void initLogDirectory() {
  if (!SPIFFS.exists(LOG_DIR)) {
    Serial.println("Logs directory bestaat niet, wordt aangemaakt...");

    if (SPIFFS.mkdir(LOG_DIR)) {
      Serial.println("Logs directory succesvol aangemaakt");
    } else {
      File dir = SPIFFS.open(LOG_DIR, FILE_WRITE);
      if (dir) {
        dir.close();
        Serial.println("Logs directory aangemaakt (oude methode)");
      } else {
        Serial.println("Failed to create logs directory");
      }
    }
  } else {
    Serial.println("Logs directory bestaat al");
  }
}

void createNewLogFile() {
  initLogDirectory();

  time_t now;
  struct tm timeinfo;
  time(&now);
  
  // Check if time is properly synchronized (not Unix epoch)
  if (now < 1000000000) { // If time is before year 2001, use current date fallback
    // Use a default date format based on system uptime
    unsigned long uptime = millis() / 1000;
    unsigned long days = uptime / 86400;
    unsigned long hours = (uptime % 86400) / 3600;
    unsigned long minutes = (uptime % 3600) / 60;
    
    // Create a timestamp based on current date (you can adjust this as needed)
    timeinfo.tm_year = 2025 - 1900; // 2025
    timeinfo.tm_mon = 0;            // January (0-based)
    timeinfo.tm_mday = 15;          // 15th
    timeinfo.tm_hour = hours % 24;
    timeinfo.tm_min = minutes % 60;
    timeinfo.tm_sec = uptime % 60;
  } else {
    localtime_r(&now, &timeinfo);
  }

  char timestamp[32];
  sprintf(timestamp, "%02d%02d%04d", timeinfo.tm_mday, timeinfo.tm_mon + 1, timeinfo.tm_year + 1900);

  testCounter++;

  currentLogFile = String(LOG_DIR) + "/" + String(timestamp) + "_" +
                   String(2021000 + testCounter) + ".csv";

  Serial.println("Attempting to create log file: " + currentLogFile);

  File file = SPIFFS.open(currentLogFile, FILE_WRITE);
  if (file) {
    // Metadata
    file.println(
        "This log file is generated by a i@control performance logger.");
    file.println("i@control wish you a lot of fun in your Alfa Romeo "
                 "4C/Giulietta QV");
    file.println("");

    // Logging-to and following metadata, then blank line
    String loggingToFormat = String(timeinfo.tm_year + 1900);
    if (timeinfo.tm_mon + 1 < 10)
      loggingToFormat += "0";
    loggingToFormat += String(timeinfo.tm_mon + 1);
    if (timeinfo.tm_mday < 10)
      loggingToFormat += "0";
    loggingToFormat += String(timeinfo.tm_mday) + "_#" +
                       String(2021000 + testCounter) + "_000.log";
    file.println("Logging to: " + loggingToFormat);

    file.println("Application type: Performance logger");
    file.println("Software version: 1.0 Released");
    file.println("Hardware version: 8.x & 9.x");
    file.println("Car type: Alfa Romeo Giulietta QV");
    file.println("Selected car mass at start of the logging: 1940");
    file.println("Serial number: " + String(2021000 + testCounter));
    file.println("");

    // Time & Date with their own blank lines around them
    String timeStr = "";
    if (timeinfo.tm_hour < 10)
      timeStr += "0";
    timeStr += String(timeinfo.tm_hour) + " : ";
    if (timeinfo.tm_min < 10)
      timeStr += "0";
    timeStr += String(timeinfo.tm_min);
    file.println("Time: " + timeStr);

    String dateStr = "";
    if (timeinfo.tm_mday < 10)
      dateStr += "0";
    dateStr += String(timeinfo.tm_mday) + " ";
    if (timeinfo.tm_mon + 1 < 10)
      dateStr += "0";
    dateStr +=
        String(timeinfo.tm_mon + 1) + " " + String(timeinfo.tm_year + 1900);
    file.println("Date: " + dateStr);
    file.println("");

    // Column headers as TAB-separated row
    file.println("Time stamp\tDNA position\tAccelerator position\tThrottle "
                 "position\tSteering wheel position\t"
                 "Brake pressure\tSelected gear\tSpeed\tAtmospheric "
                 "pressure\tBoost target ECM1\tBoost ECM1\t"
                 "Boost target ECM2\tBoost ECM2\tFuel pressure\tSpark "
                 "advance\tIntake tmp\tPump speed\tEngine oil tmp\t"
                 "Coolant tmp\tGearbox oil tmp\tDiff oil tmp left\tDiff oil "
                 "tmp right\tRPM\tEngine Power\tEngine Trq\t"
                 "Used car mass\tLGf\tTGf\tOutside tmp\tTarget tmp\tSeat "
                 "tmp\tSteer tmp\tBrake LF tmp\tBrake RF tmp\t"
                 "Brake LR tmp\tBrake RR tmp\tLambda PCM1\tAFR PCM1\tTyre LF "
                 "tmp\tTyre RF tmp\tTyre LR tmp\tTyre RR tmp\t"
                 "Left tank floating valve\tRight tank floating valve\tIBS "
                 "level\tIBS voltage\t"
                 "PCM 1\tPCM 1\tPCM 1\tPCM 1\tPCM 1\tPCM 1"
                 "\tPCM 1\tPCM 1\tPCM 1\tPCM 1\t"
                 "PCM 2\tPCM 2\tPCM 2\tPCM 2\tPCM 2\tPCM 2"
                 "\tPCM 2\tPCM 2\tPCM 2\tPCM 2");

    // Units row as TAB-separated row
    file.println("sec\t#\t%\t%\tº\t%\t#"
                 "\tKMH\tmbar\tmbar\tmbar\tmbar\tmbar\tmbar\tº\tºC\t%"
                 "\tºC\tºC\tºC\tºC\tºC\t"
                 "rpm\thp\tNm\tkg\tm/s²\tm/"
                 "s²\tºC\tºC\tºC\tºC\tºC\tºC\tºC\tºC\t\t\tºC\tºC\tºC\tºC\t%\t%"
                 "\t%\tVolt\t"
                 "DTC 1\tDTC 2\tDTC 3\tDTC 4\tDTC 5\tDTC 6\tDTC 7\tDTC 8\tDTC "
                 "9\tDTC 10\t"
                 "DTC 1\tDTC 2\tDTC 3\tDTC 4\tDTC 5\tDTC 6\tDTC 7\tDTC 8\tDTC "
                 "9\tDTC 10");

    file.close();
    Serial.println("Log file initialized: " + currentLogFile);
  } else {
    Serial.println("Failed to create log file: " + currentLogFile);
    currentLogFile = "";
  }
}

void logOBD2Data() {
  if (currentLogFile.isEmpty()) {
    Serial.println("Cannot log data: No active log file");
    return;
  }

  File file = SPIFFS.open(currentLogFile, "a");
  if (file) {
    float timestamp = millis() / 1000.0;

    if (testMode) {
      // Generate realistic test data that changes over time
      testCounter++;
      float baseTime = timestamp;

      // Simulate realistic driving patterns
      float testRPM = 1000 + (sin(baseTime * 0.5) * 2000) + 1500;
      float testSpeed = 30 + (sin(baseTime * 0.3) * 40);
      float testLoad = 20 + (sin(baseTime * 0.4) * 30);
      float testTemp = 90 + (sin(baseTime * 0.1) * 10);
      float testThrottle = 10 + (sin(baseTime * 0.6) * 40);

      // Write test data in same CSV format - all fields up to IBS voltage
      file.print(String(timestamp, 2));                           // Time stamp
      file.print("\t1");                                          // DNA position  
      file.print("\t" + String(testThrottle, 1));                // Accelerator position
      file.print("\t" + String(testThrottle, 1));                // Throttle position
      file.print("\t0");                                         // Steering wheel position
      file.print("\t0");                                         // Brake pressure
      file.print("\t3");                                         // Selected gear
      file.print("\t" + String((int)testSpeed));                 // Speed
      file.print("\t1013");                                      // Atmospheric pressure
      file.print("\t1200");                                      // Boost target ECM1
      file.print("\t1150");                                      // Boost ECM1
      file.print("\t0");                                         // Boost target ECM2
      file.print("\t0");                                         // Boost ECM2
      file.print("\t3500");                                      // Fuel pressure
      file.print("\t15");                                        // Spark advance
      file.print("\t" + String(25 + sin(baseTime * 0.2) * 5, 1)); // Intake tmp
      file.print("\t75");                                        // Pump speed
      file.print("\t" + String(95 + sin(baseTime * 0.15) * 10, 1)); // Engine oil tmp
      file.print("\t" + String(testTemp, 1));                    // Coolant tmp
      file.print("\t" + String(85 + sin(baseTime * 0.12) * 5, 1)); // Gearbox oil tmp
      file.print("\t" + String(40 + sin(baseTime * 0.18) * 3, 1)); // Diff oil tmp left
      file.print("\t" + String(42 + sin(baseTime * 0.16) * 3, 1)); // Diff oil tmp right
      file.print("\t" + String((int)testRPM));                   // RPM
      file.print("\t" + String(180 + sin(baseTime * 0.25) * 120, 0)); // Engine Power
      file.print("\t" + String(320 + sin(baseTime * 0.25) * 200, 0)); // Engine Trq
      file.print("\t1940");                                      // Used car mass
      file.print("\t" + String(0.5 + sin(baseTime * 0.4) * 0.3, 1)); // LGf
      file.print("\t" + String(0.2 + sin(baseTime * 0.35) * 0.2, 1)); // TGf
      file.print("\t" + String(22 + sin(baseTime * 0.08) * 2, 1)); // Outside tmp
      file.print("\t21");                                        // Target tmp
      file.print("\t20");                                        // Seat tmp
      file.print("\t35");                                        // Steer tmp
      file.print("\t" + String(180 + sin(baseTime * 0.22) * 20, 0)); // Brake LF tmp
      file.print("\t" + String(185 + sin(baseTime * 0.21) * 20, 0)); // Brake RF tmp
      file.print("\t" + String(160 + sin(baseTime * 0.23) * 20, 0)); // Brake LR tmp
      file.print("\t" + String(165 + sin(baseTime * 0.24) * 20, 0)); // Brake RR tmp
      file.print("\t" + String(0.95 - sin(baseTime * 0.1) * 0.05, 2)); // Lambda PCM1
      file.print("\t" + String(14.2 - sin(baseTime * 0.1) * 0.5, 1)); // AFR PCM1
      file.print("\t" + String(45 + sin(baseTime * 0.3) * 10, 0)); // Tyre LF tmp
      file.print("\t" + String(48 + sin(baseTime * 0.31) * 10, 0)); // Tyre RF tmp
      file.print("\t" + String(42 + sin(baseTime * 0.29) * 8, 0)); // Tyre LR tmp
      file.print("\t" + String(40 + sin(baseTime * 0.28) * 8, 0)); // Tyre RR tmp
      file.print("\t5");                                         // Left tank floating valve
      file.print("\t8");                                         // Right tank floating valve
      file.print("\t95");                                        // IBS level
      file.print("\t" + String(12.8 + sin(baseTime * 0.05) * 0.2, 1)); // IBS voltage
      file.println();

      Serial.println("Test data logged (#" + String(testCounter) + ") to " + currentLogFile);
    } else {
      // Write real OBD2 data in CSV format (tab-separated) - all fields up to IBS voltage
      file.print(String(timestamp, 2));                           // Time stamp
      file.print("\t1");                                          // DNA position (default)
      file.print("\t" + String(obd2Data.throttlePosition, 1));    // Accelerator position
      file.print("\t" + String(obd2Data.throttlePosition, 1));    // Throttle position
      file.print("\t0");                                         // Steering wheel position (not available)
      file.print("\t0");                                         // Brake pressure (not available)
      file.print("\t3");                                         // Selected gear (default)
      file.print("\t" + String(obd2Data.vehicleSpeed));          // Speed
      file.print("\t1013");                                      // Atmospheric pressure (default)
      file.print("\t" + String(obd2Data.turboPressure * 1000, 0)); // Boost target ECM1
      file.print("\t" + String(obd2Data.turboPressure * 950, 0)); // Boost ECM1
      file.print("\t0");                                         // Boost target ECM2 (not available)
      file.print("\t0");                                         // Boost ECM2 (not available)
      file.print("\t3500");                                      // Fuel pressure (default)
      file.print("\t15");                                        // Spark advance (default)
      file.print("\t" + String(obd2Data.intakeTemp, 1));         // Intake tmp
      file.print("\t75");                                        // Pump speed (default)
      file.print("\t" + String(obd2Data.oilTemp, 1));           // Engine oil tmp
      file.print("\t" + String(obd2Data.coolantTemp, 1));       // Coolant tmp
      file.print("\t" + String(obd2Data.transmissionTemp, 1));  // Gearbox oil tmp
      file.print("\t40");                                        // Diff oil tmp left (default)
      file.print("\t42");                                        // Diff oil tmp right (default)
      file.print("\t" + String(obd2Data.engineRPM));            // RPM
      file.print("\t" + String((obd2Data.engineRPM * obd2Data.engineLoad) / 100, 0)); // Engine Power (calculated)
      file.print("\t" + String((obd2Data.engineRPM * obd2Data.engineLoad) / 50, 0));  // Engine Trq (calculated)
      file.print("\t1940");                                      // Used car mass (default)
      file.print("\t0.5");                                       // LGf (default)
      file.print("\t0.2");                                       // TGf (default)
      file.print("\t22");                                        // Outside tmp (default)
      file.print("\t21");                                        // Target tmp (default)
      file.print("\t20");                                        // Seat tmp (default)
      file.print("\t35");                                        // Steer tmp (default)
      file.print("\t180");                                       // Brake LF tmp (default)
      file.print("\t185");                                       // Brake RF tmp (default)
      file.print("\t160");                                       // Brake LR tmp (default)
      file.print("\t165");                                       // Brake RR tmp (default)
      file.print("\t0.95");                                      // Lambda PCM1 (default)
      file.print("\t14.2");                                      // AFR PCM1 (default)
      file.print("\t45");                                        // Tyre LF tmp (default)
      file.print("\t48");                                        // Tyre RF tmp (default)
      file.print("\t42");                                        // Tyre LR tmp (default)
      file.print("\t40");                                        // Tyre RR tmp (default)
      file.print("\t" + String(obd2Data.fuelLevel, 0));         // Left tank floating valve
      file.print("\t" + String(obd2Data.fuelLevel, 0));         // Right tank floating valve
      file.print("\t95");                                        // IBS level (default)
      file.print("\t12.8");                                      // IBS voltage (default)
      file.println();

      Serial.println("Real data logged to " + currentLogFile);
    }

    file.close();
  } else {
    Serial.println("Failed to open log file for appending.");
  }
}

void startLogging() {
  if (!isLogging) {
    isLogging = true;
    createNewLogFile();
    Serial.println("Logging gestart naar bestand: " + currentLogFile);
  }
}

void stopLogging() {
  if (isLogging) {
    isLogging = false;
    Serial.println("Logging gestopt");
  }
}

void processLogging() {
  if (isLogging && (millis() - lastLogTime >= LOG_INTERVAL)) {
    lastLogTime = millis();
    logOBD2Data();
  }
}

String humanReadableSize(size_t bytes) {
  if (bytes < 1024)
    return String(bytes) + " B";
  else if (bytes < (1024 * 1024))
    return String(bytes / 1024.0, 1) + " KB";
  else if (bytes < (1024 * 1024 * 1024))
    return String(bytes / 1024.0 / 1024.0, 1) + " MB";
  else
    return String(bytes / 1024.0 / 1024.0 / 1024.0, 1) + " GB";
}

String extractDateTime(String filename) {
  // Extract just the filename without path
  String basename = filename;
  int lastSlash = filename.lastIndexOf('/');
  if (lastSlash >= 0) {
    basename = filename.substring(lastSlash + 1);
  }

  // Try to extract from "test_YYYYMMDD_HHMMSS_X.csv" format
  int start = basename.indexOf("test_");
  if (start >= 0) {
    start += 5;
    if (start + 15 <= basename.length()) {
      String datepart = basename.substring(start, start + 8);
      String timepart = basename.substring(start + 9, start + 15);

      return datepart.substring(0, 4) + "-" + datepart.substring(4, 6) + "-" +
             datepart.substring(6, 8) + " " + timepart.substring(0, 2) + ":" +
             timepart.substring(2, 4) + ":" + timepart.substring(4, 6);
    }
  }

  // Try to extract from "DDMMYYYY_SERIALNUM.csv" format
  int underscorePos = basename.indexOf('_');
  if (underscorePos == 8 && basename.length() >= 17) {
    String datepart = basename.substring(0, 8);
    if (datepart.length() == 8) {
      // Format: DDMMYYYY -> YYYY-MM-DD
      String day = datepart.substring(0, 2);
      String month = datepart.substring(2, 4);
      String year = datepart.substring(4, 8);
      return year + "-" + month + "-" + day + " 10:30:00";
    }
  }

  // Fallback: return current date/time or default if time not synced
  time_t now;
  struct tm timeinfo;
  time(&now);
  
  if (now < 1000000000) { // Time not synced yet
    // Use system uptime to create a reasonable timestamp
    unsigned long uptime = millis() / 1000;
    unsigned long hours = (uptime / 3600) % 24;
    unsigned long minutes = (uptime % 3600) / 60;
    unsigned long seconds = uptime % 60;
    
    return "2025-01-15 " + String(hours < 10 ? "0" : "") + String(hours) + ":" + 
           String(minutes < 10 ? "0" : "") + String(minutes) + ":" + 
           String(seconds < 10 ? "0" : "") + String(seconds);
  } else {
    localtime_r(&now, &timeinfo);
    
    char todayDate[20];
    sprintf(todayDate, "%04d-%02d-%02d %02d:%02d:%02d", 
            timeinfo.tm_year + 1900,
            timeinfo.tm_mon + 1, 
            timeinfo.tm_mday,
            timeinfo.tm_hour,
            timeinfo.tm_min,
            timeinfo.tm_sec);

    return String(todayDate);
  }
}